## build/conf/bblayers.conf
```bitbake
# POKY_BBLAYERS_CONF_VERSION is increased each time build/conf/bblayers.conf
# changes incompatibly
POKY_BBLAYERS_CONF_VERSION = "2"

BBPATH = "${TOPDIR}"
BBFILES ?= ""

BBLAYERS ?= " \
  /mnt/yocto/domotik/yocto-domotik/poky/meta \
  /mnt/yocto/domotik/yocto-domotik/poky/meta-poky \
  /mnt/yocto/domotik/yocto-domotik/poky/meta-yocto-bsp \
  /mnt/yocto/domotik/yocto-domotik/meta-openembedded/meta-networking \
  /mnt/yocto/domotik/yocto-domotik/meta-openembedded/meta-oe \
  /mnt/yocto/domotik/yocto-domotik/meta-openembedded/meta-python \
  /mnt/yocto/domotik/yocto-domotik/meta-raspberrypi \
  /mnt/yocto/domotik/yocto-domotik/meta-domotik \
  "
```

## meta-domotik/conf/layer.conf
```bitbake
# We have a conf and classes directory, add to BBPATH
BBPATH .= ":${LAYERDIR}"

# We have recipes-* directories, add to BBFILES
BBFILES += "${LAYERDIR}/recipes-*/*/*.bb \
            ${LAYERDIR}/recipes-*/*/*.bbappend"

BBFILE_COLLECTIONS += "meta-domotik"
BBFILE_PATTERN_meta-domotik = "^${LAYERDIR}/"
BBFILE_PRIORITY_meta-domotik = "10"

LAYERDEPENDS_meta-domotik = "core"
LAYERSERIES_COMPAT_meta-domotik = "scarthgap"
```
